## main/Kconfig.projbuild
```kconfig
menu "HID Example Configuration"
    config EXAMPLE_SSP_ENABLED
        bool "Secure Simple Pairing"
        depends on BT_CLASSIC_ENABLED
        default y
        help
            This enables the Secure Simple Pairing. If disable this option,
            Bluedroid will only support Legacy Pairing

    choice PROJECT_HID_DEVICE_ROLE
        prompt "HID Device Role"
        depends on BT_NIMBLE_ENABLED
        default PROJECT_GENERIC_ENABLE
        help
            Supported Roles for Device
            - Keyboard
            - Mouse

            If left unconfigured, the project will not support any HID devices.

        config PROJECT_GENERIC_ENABLE
            select BT_NIMBLE_HID_SERVICE
            bool "Enable Generic Device"

        config PROJECT_KBD_ENABLE
            select BT_NIMBLE_HID_SERVICE
            bool "Enable Keyboard Device"

        config PROJECT_MOUSE_ENABLE
            select BT_NIMBLE_HID_SERVICE
            bool "Enable Mouse Device"
    endchoice

    config PROJECT_HID_DEVICE_ROLE
        int
        default 0 if PROJECT_GENERIC_ENABLE
        default 1 if PROJECT_KBD_ENABLE
        default 2 if PROJECT_MOUSE_ENABLE
endmenu
```
